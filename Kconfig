## Kconfig
```kconfig
# Felix OS Root Kconfig Specification

mainmenu "Felix OS Configuration"

# =============================================================================
# Architecture Selection
# =============================================================================
menu "Target Architecture"

choice
    prompt "Target CPU Architecture"
    default ARCH_RISCV64

config ARCH_RISCV64
    bool "RISC-V 64-bit (RV64GC)"
    help
      Select for 64-bit RISC-V targets such as the Microchip PolarFire SoC.

config ARCH_ARM_CORTEX_M
    bool "ARM Cortex-M (32-bit)"
    help
      Select for 32-bit ARM Cortex-M targets such as NXP LPC54S018 (M4F)
      or ALIF Ensemble (M55).

config ARCH_AARCH64
    bool "ARM AArch64 (64-bit)"
    help
      Select for 64-bit ARM Cortex-A targets such as Raspberry Pi (3/4/5).

endchoice

config ARCH_NAME
    string
    default "riscv64" if ARCH_RISCV64
    default "arm" if ARCH_ARM_CORTEX_M
    default "aarch64" if ARCH_AARCH64

endmenu

# =============================================================================
# Target Platform & Board
# =============================================================================
menu "Target Platform & Board"

choice
    prompt "Target Board"
    default BOARD_MPFS_DISCO_KIT

config BOARD_MPFS_DISCO_KIT
    bool "Microchip PolarFire SoC Discovery Kit"
    depends on ARCH_RISCV64
    help
      Microchip PolarFire SoC Discovery Kit (MPFS-DISCO-KIT).

config BOARD_MPFS_ICICLE_KIT
    bool "Microchip PolarFire SoC Icicle Kit"
    depends on ARCH_RISCV64
    help
      Microchip PolarFire SoC Icicle Kit (MPFS-ICICLE-KIT-ES).

config BOARD_LPC54S018
    bool "NXP LPC54S018 IoT Module / EVK"
    depends on ARCH_ARM_CORTEX_M
    help
      NXP LPC54S018 Cortex-M4F development board.

config BOARD_ALIF_ENSEMBLE
    bool "ALIF Ensemble DevKit (E6/E7)"
    depends on ARCH_ARM_CORTEX_M
    help
      ALIF Semiconductor Ensemble DevKit.

config BOARD_RPI
    bool "Raspberry Pi"
    depends on ARCH_AARCH64
    help
      Raspberry Pi 3, 4, or Compute Module 4.

endchoice

endmenu

# =============================================================================
# Memory Model & Execution Environment
# =============================================================================
menu "Memory Model & Execution Profile"

choice
    prompt "Memory Target Profile"
    default MEM_PROFILE_DDR

config MEM_PROFILE_LIM
    bool "LIM Only (Minimal SRAM, <512 KB)"
    help
      Run monolithic kernel entirely from SRAM/LIM scratchpad memory.
      Optimized for deterministic real-time control.
      Disables dynamic ELF loading and external tools.

config MEM_PROFILE_DDR
    bool "DDR / External SDRAM (High Capacity)"
    help
      Run kernel and user applications from DDR memory space.
      Enables dynamic ELF loading, full POSIX, and external Toybox.

config MEM_PROFILE_AMP
    bool "Asymmetric Multiprocessing (AMP)"
    help
      Heterogeneous core partitioning. Real-time control cores run
      from SRAM/LIM; supervisor core runs Felix in DDR.

endchoice

config HEAP_SIZE_BYTES
    int "Linker Heap Size (in bytes)"
    default 1024 if MEM_PROFILE_LIM
    default 33554432 if MEM_PROFILE_DDR
    default 8388608 if MEM_PROFILE_AMP
    help
      Size of the physical heap segment (__heap_start to __heap_end).

endmenu

# =============================================================================
# Kernel Subsystems & OSAL
# =============================================================================
menu "Kernel Subsystems"

config FELIX_VFS
    bool "Virtual File System (VFS)"
    default y
    help
      Enables POSIX Virtual File System node resolution and file descriptors.

config FELIX_VFS_MAX_OPEN_FILES
    int "Maximum Open File Descriptors per Process"
    depends on FELIX_VFS
    default 32

config FELIX_FATFS
    bool "FAT32 / exFAT Filesystem Support"
    depends on FELIX_VFS
    default y
    help
      Enables ChaN FatFs VFS integration for SD cards and block storage.

config FELIX_BLK_MANAGER
    bool "Storage Block Device Manager"
    depends on FELIX_VFS
    default y
    help
      Enables partition parsing (MBR / GPT) and block device handling.

config FELIX_OSAL_FREERTOS
    bool "FreeRTOS Scheduling & Synchronization Engine"
    default y
    help
      Use FreeRTOS as the underlying real-time kernel engine.

endmenu

# =============================================================================
# POSIX API Layer
# =============================================================================
menu "POSIX Compatibility Layer"

config FELIX_POSIX
    bool "Enable POSIX System Calls & Shims"
    default y
    help
      Provides POSIX standard C functions (unistd, stat, fcntl, time).

config FELIX_FREERTOS_PLUS_POSIX
    bool "Enable FreeRTOS+POSIX Engine"
    depends on FELIX_POSIX && FELIX_OSAL_FREERTOS
    default y
    help
      Integrates official FreeRTOS-Plus-POSIX for pthreads, mutexes,
      and semaphores.

endmenu

# =============================================================================
# Dynamic Loading & Shared Libraries
# =============================================================================
menu "Dynamic Loading & Shared Libraries"

config FELIX_ELF_LOADER
    bool "Position-Independent Dynamic ELF Loader (PIE)"
    depends on MEM_PROFILE_DDR || MEM_PROFILE_AMP
    default y
    help
      Enables loading external user binaries from VFS (/bin) into dynamic RAM
      at runtime.

config FELIX_SHARED_LIBRARIES
    bool "Dynamic Shared Libraries & Plugins (dlopen/dlsym)"
    depends on FELIX_ELF_LOADER
    default y
    help
      Enables kernel symbol export and runtime driver/extension module loading.

endmenu

# =============================================================================
# Shell & User Space Utilities
# =============================================================================
menu "Shell & Utilities"

config FELIX_SHELL
    bool "Interactive Felix Shell (flx_sh)"
    default y
    help
      Built-in command-line interface.

config FELIX_SHELL_LINENOISE
    bool "Linenoise Command-Line Editing & History"
    depends on FELIX_SHELL
    default y
    help
      Enables tab-completion, history, and cursor movement in shell.

config FELIX_TOYBOX
    bool "Toybox Utility Suite"
    default y
    help
      Enables Toybox command-line utilities. In DDR mode, Toybox runs
      externally via the ELF loader from /bin/toybox on the SD card.

endmenu
```

## configs/disco_amp_defconfig
```kconfig
CONFIG_ARCH_RISCV64=y
CONFIG_BOARD_MPFS_DISCO_KIT=y
CONFIG_MEM_PROFILE_AMP=y
CONFIG_HEAP_SIZE_BYTES=8388608
CONFIG_FELIX_VFS=y
CONFIG_FELIX_VFS_MAX_OPEN_FILES=32
CONFIG_FELIX_FATFS=y
CONFIG_FELIX_BLK_MANAGER=y
CONFIG_FELIX_OSAL_FREERTOS=y
CONFIG_FELIX_POSIX=y
CONFIG_FELIX_FREERTOS_PLUS_POSIX=y
CONFIG_FELIX_ELF_LOADER=y
CONFIG_FELIX_SHARED_LIBRARIES=y
CONFIG_FELIX_SHELL=y
CONFIG_FELIX_SHELL_LINENOISE=y
CONFIG_FELIX_TOYBOX=y
```

## configs/disco_ddr_defconfig
```kconfig
CONFIG_ARCH_RISCV64=y
CONFIG_BOARD_MPFS_DISCO_KIT=y
CONFIG_MEM_PROFILE_DDR=y
CONFIG_HEAP_SIZE_BYTES=33554432
CONFIG_FELIX_VFS=y
CONFIG_FELIX_VFS_MAX_OPEN_FILES=32
CONFIG_FELIX_FATFS=y
CONFIG_FELIX_BLK_MANAGER=y
CONFIG_FELIX_OSAL_FREERTOS=y
CONFIG_FELIX_POSIX=y
CONFIG_FELIX_FREERTOS_PLUS_POSIX=y
CONFIG_FELIX_POSIX_PTHREAD=y
CONFIG_FELIX_POSIX_SEMAPHORE=y
CONFIG_FELIX_POSIX_MQUEUE=y
CONFIG_FELIX_POSIX_TIMER=y
CONFIG_FELIX_ELF_LOADER=y
CONFIG_FELIX_SHARED_LIBRARIES=y
CONFIG_FELIX_SHELL=y
CONFIG_FELIX_SHELL_LINENOISE=y
CONFIG_FELIX_TOYBOX=y
CONFIG_FELIX_TEST_SUITE=y
CONFIG_FELIX_TEST_ALL=y
CONFIG_FELIX_TEST_MEM=y
CONFIG_FELIX_TEST_DEV=y
CONFIG_FELIX_TEST_VFS=y
CONFIG_FELIX_TEST_POSIX=y
CONFIG_FELIX_TEST_WORDEXP=y
CONFIG_FELIX_TEST_IO=y
CONFIG_FELIX_TEST_PATH=y
CONFIG_FELIX_TEST_STORAGE=y
CONFIG_FELIX_TEST_STRESS=y
```

## configs/disco_lim_defconfig
```kconfig
CONFIG_ARCH_RISCV64=y
CONFIG_BOARD_MPFS_DISCO_KIT=y
CONFIG_MEM_PROFILE_LIM=y
CONFIG_HEAP_SIZE_BYTES=1024
CONFIG_FELIX_VFS=y
CONFIG_FELIX_VFS_MAX_OPEN_FILES=16
CONFIG_FELIX_FATFS=y
CONFIG_FELIX_BLK_MANAGER=y
CONFIG_FELIX_OSAL_FREERTOS=y
CONFIG_FELIX_POSIX=y
# CONFIG_FELIX_ELF_LOADER is not set
# CONFIG_FELIX_SHARED_LIBRARIES is not set
CONFIG_FELIX_SHELL=y
CONFIG_FELIX_SHELL_LINENOISE=y
# CONFIG_FELIX_TOYBOX is not set
```

## scripts/kconfig.py
```kconfig
#!/usr/bin/env python3
"""
Felix OS Kconfig Automation Runner
Manages .config and autoconf.h generation using vendored kconfiglib.
"""

import sys
import os

# Locate script and felix root directories
SCRIPT_DIR = os.path.dirname(os.path.abspath(__file__))
FELIX_ROOT = os.path.abspath(os.path.join(SCRIPT_DIR, ".."))
WORKSPACE_ROOT = os.path.abspath(os.path.join(FELIX_ROOT, ".."))

# Add vendored kconfiglib to Python path
sys.path.insert(0, os.path.join(SCRIPT_DIR, "kconfig"))

try:
    import kconfiglib
except ImportError:
    sys.exit("Error: kconfiglib not found in felix/scripts/kconfig/")

KCONFIG_FILE = os.path.join(FELIX_ROOT, "Kconfig")
DOT_CONFIG = os.path.join(WORKSPACE_ROOT, ".config")
AUTOCONF_HEADER = os.path.join(FELIX_ROOT, "include", "generated", "autoconf.h")
CONFIGS_DIR = os.path.join(FELIX_ROOT, "configs")


def ensure_dirs():
    os.makedirs(os.path.dirname(AUTOCONF_HEADER), exist_ok=True)
    os.makedirs(CONFIGS_DIR, exist_ok=True)


def generate_header(kconf):
    ensure_dirs()
    kconf.write_autoconf(AUTOCONF_HEADER)
    print(f"[Kconfig] Generated C header: {os.path.relpath(AUTOCONF_HEADER, WORKSPACE_ROOT)}")


def cmd_defconfig(defconfig_arg):
    ensure_dirs()
    # Resolve defconfig path
    if os.path.isabs(defconfig_arg):
        path = defconfig_arg
    elif os.path.exists(os.path.join(CONFIGS_DIR, defconfig_arg)):
        path = os.path.join(CONFIGS_DIR, defconfig_arg)
    elif os.path.exists(defconfig_arg):
        path = defconfig_arg
    else:
        sys.exit(f"Error: Defconfig not found: {defconfig_arg}")

    kconf = kconfiglib.Kconfig(KCONFIG_FILE)
    kconf.load_config(path)
    kconf.write_config(DOT_CONFIG)
    print(f"[Kconfig] Loaded defconfig: {os.path.basename(path)}")
    print(f"[Kconfig] Written configuration: {os.path.relpath(DOT_CONFIG, WORKSPACE_ROOT)}")
    generate_header(kconf)


def cmd_genheader():
    ensure_dirs()
    if not os.path.exists(DOT_CONFIG):
        print(f"[Kconfig] No .config found, loading defaults from Kconfig...")
        kconf = kconfiglib.Kconfig(KCONFIG_FILE)
        kconf.write_config(DOT_CONFIG)
    else:
        kconf = kconfiglib.Kconfig(KCONFIG_FILE)
        kconf.load_config(DOT_CONFIG)

    generate_header(kconf)


def cmd_menuconfig():
    import menuconfig
    # Set environment variables for menuconfig
    os.environ["KCONFIG_CONFIG"] = DOT_CONFIG
    sys.argv = [sys.argv[0], KCONFIG_FILE]
    menuconfig._main()
    # After menuconfig closes, update autoconf.h
    cmd_genheader()


def cmd_guiconfig():
    import guiconfig
    # Set environment variables for guiconfig
    os.environ["KCONFIG_CONFIG"] = DOT_CONFIG
    sys.argv = [sys.argv[0], KCONFIG_FILE]
    guiconfig._main()
    # After guiconfig closes, update autoconf.h
    cmd_genheader()


def print_help():
    print("""Felix OS Kconfig Helper

Usage:
    python felix/scripts/kconfig.py <command> [args]

Commands:
    defconfig <name>    Load a predefined configuration (e.g. disco_ddr_defconfig)
    genheader           Regenerate include/generated/autoconf.h from current .config
    menuconfig          Interactive terminal configuration menu (ncurses)
    guiconfig           Graphical configuration editor (Tk GUI)
    help                Show this help message
""")


def main():
    if len(sys.argv) < 2:
        print_help()
        sys.exit(1)

    cmd = sys.argv[1].lower()

    if cmd == "defconfig":
        if len(sys.argv) < 3:
            sys.exit("Error: defconfig requires a configuration name or path.")
        cmd_defconfig(sys.argv[2])
    elif cmd in ("genheader", "sync"):
        cmd_genheader()
    elif cmd == "menuconfig":
        cmd_menuconfig()
    elif cmd in ("guiconfig", "gui"):
        cmd_guiconfig()
    elif cmd in ("--help", "-h", "help"):
        print_help()
    else:
        sys.exit(f"Unknown command: {cmd}")


if __name__ == "__main__":
    main()
```
